#include "Polaris_pins.dtsi"
#include <behaviors/rgbled_widget.dtsi>

#include "Polaris_layout.dtsi"
#include "Polaris_modules.dtsi"
#include "Polaris_hardware.dtsi"

/ {
	chosen {
		zmk,physical-layout = &layout_Polaris;
		zmk,battery = &vbatt;
		// zephyr,boot-mode = &boot_mode0;
	};

	// bootloader_trigger: bootloader_trigger {
	// 	compatible = "zmk,cdc-acm-bootloader-trigger";
	// 	cdc-port = <&snippet_zmk_usb_logging_uart>;
	// };
};

// &gpregret1 {
// 	status = "okay";

// 	boot_mode0: boot_mode@0 {
// 		compatible = "zephyr,retention";
// 		status = "okay";
// 		reg = <0x0 0x1>;
// 	};
// };

// &zephyr_udc0 {
// 	snippet_bootloader_trigger_uart: snippet_bootloader_trigger_uart {
// 		compatible = "zephyr,cdc-acm-uart";
// 	};
// };
