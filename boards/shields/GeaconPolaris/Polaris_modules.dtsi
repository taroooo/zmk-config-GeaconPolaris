/ {
	analog_stick_layout: analog_stick_layout {
		compatible = "zmk,physical-layout-custom-module";
		display-name = "Analog Stick";
		type = "analog-stick";
		width = <100>;
		height = <100>;
		x = <350>;
		y = <450>;
		linked-device-identifiers = "analog_input_0";
		linked-subsystems = "dya__studio";
	};

	trackball_layout: trackball_layout {
		compatible = "zmk,physical-layout-trackball";
		display-name = "Trackball";
		size = <120>;
		x = <930>;
		y = <160>;
		linked-device-identifiers = "trackball";
		linked-subsystems = "zmk__trackball";
	};

	oled_layout: oled_layout {
		compatible = "zmk,physical-layout-custom-module";
		display-name = "OLED";
		type = "display";
		width = <70>;
		height = <220>;
		x = <750>;
		y = <200>;
		linked-device-identifiers = "oled";
		linked-subsystems = "zmk__display";
	};
};
